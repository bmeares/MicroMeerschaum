## Kconfig
```kconfig
menu "MicroMeerschaum"
    config MICROMEERSCHAUM_HTTPS
        bool "Enable HTTPS batch sender"
        default n
        help
            Provide the ESP-IDF client for the hosted binary ingest endpoint.
            The application provisions the receiver identity, URL and API key.
    config MICROMEERSCHAUM_SQLITE
        bool "Enable the SQLite local Pipe instance"
        default n
        help
            Store typed rows and outgoing records on a mounted LittleFS volume.
    config MICROMEERSCHAUM_NIMBLE
        bool "Enable NimBLE peer transport"
        depends on BT_NIMBLE_ENABLED && BT_NIMBLE_ROLE_CENTRAL && BT_NIMBLE_ROLE_PERIPHERAL
        default n
    config MICROMEERSCHAUM_DEVICE_SESSION
        bool "Enable the line-framed device management session"
        default n
        help
            Provide the bounded JSON session for explicitly admitted actions
            and published Pipe registrations over application-owned transports.
    config MICROMEERSCHAUM_SESSION_GATT
        bool "Enable the authenticated GATT management service"
        depends on MICROMEERSCHAUM_DEVICE_SESSION && BT_NIMBLE_ENABLED && BT_NIMBLE_ROLE_PERIPHERAL
        default n
    config MICROMEERSCHAUM_SESSION_STACK
        int "Management worker stack (bytes)"
        depends on MICROMEERSCHAUM_SESSION_GATT
        range 4096 65536
        default 8192
endmenu
```

## examples/esp-idf/session/main/Kconfig.projbuild
```kconfig
menu "Device session example"
    config MM_EXAMPLE_USB_JTAG
        bool "Use the built-in USB Serial/JTAG port (default: USB-to-UART bridge)"
        depends on SOC_USB_SERIAL_JTAG_SUPPORTED
        default n
    config MM_EXAMPLE_PEER_ADDRESS
        string "Enrolled BLE identity address, e.g. AA:BB:CC:DD:EE:FF"
        default ""
        help
            With no enrolled address only the wired console is started.
    config MM_EXAMPLE_PEER_TYPE
        int "Enrolled BLE identity address type (public=0, random=1)"
        range 0 1
        default 0
endmenu
```

## examples/esp-idf/session/sdkconfig.defaults
```kconfig
CONFIG_BT_ENABLED=y
CONFIG_BT_NIMBLE_ENABLED=y
CONFIG_BT_NIMBLE_NVS_PERSIST=y
CONFIG_MICROMEERSCHAUM_DEVICE_SESSION=y
CONFIG_MICROMEERSCHAUM_SESSION_GATT=y
CONFIG_ESP_MAIN_TASK_STACK_SIZE=8192
CONFIG_ESPTOOLPY_FLASHSIZE_4MB=y
CONFIG_PARTITION_TABLE_SINGLE_APP_LARGE=y
```

## examples/esp-idf/sqlite/main/Kconfig.projbuild
```kconfig
menu "SQLite Pipe example"
    config MM_SQLITE_EXAMPLE_PROVISION
        bool "Provision a fresh demonstration database if missing"
        default n
    config MM_SQLITE_EXAMPLE_FAIL_SYNC
        bool "Exercise a failed file synchronization before collection"
        default n
        help
            The example returns EIO from the next fsync during an append,
            closes the handle and checks the recovered Pipe before continuing.
endmenu
```

## examples/esp-idf/storage/main/Kconfig.projbuild
```kconfig
menu "Storage example"

config MM_EXAMPLE_SDMMC
    bool "Use an SD card over one-bit SDMMC"
    default n
    help
        Otherwise mount a preformatted on-board LittleFS storage partition.

if MM_EXAMPLE_SDMMC
config MM_EXAMPLE_SD_CLK
    int "SD clock GPIO"
    default 14
config MM_EXAMPLE_SD_CMD
    int "SD command GPIO"
    default 15
config MM_EXAMPLE_SD_D0
    int "SD data 0 GPIO"
    default 2
endif

config MM_EXAMPLE_PROVISION
    bool "Allow the creation of this demo stream on fresh media"
    default n
    help
        Use only for initial commissioning. Reopening an existing store
        validates the Pipe, origin, generation and destination.

endmenu
```
